## Documentation/devicetree/bindings/pwm/allwinner,sun20i-pwm.yaml
```yaml
# SPDX-License-Identifier: (GPL-2.0-only OR BSD-2-Clause)
%YAML 1.2
---
$id: http://devicetree.org/schemas/pwm/allwinner,sun20i-pwm.yaml#
$schema: http://devicetree.org/meta-schemas/core.yaml#

title: Allwinner D1, T113-S3 and R329 PWM

maintainers:
  - Chen-Yu Tsai <wens@csie.org>
  - Maxime Ripard <mripard@kernel.org>

allOf:
  - $ref: pwm.yaml#

properties:
  compatible:
    const: allwinner,sun20i-d1-pwm

  reg:
    maxItems: 1

  "#pwm-cells":
    const: 3

  clocks:
    items:
      - description: 24 MHz oscillator
      - description: Bus Clock

  clock-names:
    items:
      - const: hosc
      - const: bus

  resets:
    items:
      - description: module reset

  allwinner,pwm-channels:
    $ref: /schemas/types.yaml#/definitions/uint32
    description: The number of PWM channels configured for this instance

required:
  - compatible
  - reg
  - "#pwm-cells"
  - clocks
  - clock-names
  - resets
  - allwinner,pwm-channels

additionalProperties: false

examples:
  - |
    #include <dt-bindings/clock/sun20i-d1-ccu.h>
    #include <dt-bindings/reset/sun20i-d1-ccu.h>

    pwm: pwm@2000c00 {
      compatible = "allwinner,sun20i-d1-pwm";
      reg = <0x02000c00 0x400>;
      clocks = <&dcxo>, <&ccu CLK_BUS_PWM>;
      clock-names = "hosc", "bus";
      resets = <&ccu RST_BUS_PWM>;
      allwinner,pwm-channels = <8>;
      #pwm-cells = <0x3>;
    };

...
```
